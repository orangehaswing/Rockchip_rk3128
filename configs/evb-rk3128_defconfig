## configs/evb-rk3128_defconfig
```kconfig
CONFIG_ARM=y
CONFIG_ARCH_ROCKCHIP=y
CONFIG_ROCKCHIP_RK3128=y
CONFIG_TARGET_EVB_RK3128=y
CONFIG_DEFAULT_DEVICE_TREE="rk3128-sdk"
CONFIG_FIT=y
# CONFIG_DISPLAY_CPUINFO is not set
CONFIG_CMD_BOOTZ=y
# CONFIG_CMD_IMLS is not set
CONFIG_CMD_GPT=y
CONFIG_CMD_MMC=y
CONFIG_CMD_SF=y
# CONFIG_CMD_SETEXPR is not set
CONFIG_CMD_TIME=y
CONFIG_CMD_EXT2=y
CONFIG_CMD_EXT4=y
CONFIG_CMD_FAT=y
CONFIG_CMD_FS_GENERIC=y
CONFIG_REGMAP=y
CONFIG_SYSCON=y
CONFIG_CLK=y
CONFIG_ROCKCHIP_GPIO=y
CONFIG_MMC_DW=y
CONFIG_MMC_DW_ROCKCHIP=y
CONFIG_PINCTRL=y
CONFIG_ROCKCHIP_RK3128_PINCTRL=y
CONFIG_REGULATOR_PWM=y
CONFIG_DM_REGULATOR_FIXED=y
CONFIG_RAM=y
CONFIG_DEBUG_UART=y
CONFIG_DEBUG_UART_BASE=0x20068000
CONFIG_DEBUG_UART_CLOCK=24000000
CONFIG_DEBUG_UART_SHIFT=2
CONFIG_SYS_NS16550=y
CONFIG_SYSRESET=y
CONFIG_USE_TINY_PRINTF=y
CONFIG_ERRNO_STR=y
# -------  spl  ---------
CONFIG_SPL_STACK_R_ADDR=0x80000
CONFIG_SPL_STACK_R=y
CONFIG_SPL_STACK_R_MALLOC_SIMPLE_LEN=0x2000
CONFIG_SPL_PARTITION_UUIDS=y
#CONFIG_SPL_OF_CONTROL=y
#CONFIG_SPL_REGMAP=y
#CONFIG_SPL_SYSCON=y
#CONFIG_SPL_CLK=y
#CONFIG_SPL_PINCTRL=y
CONFIG_SPL_RAM=y
#CONFIG_SPL_LOAD_FIT=y
#CONFIG_SPL_OF_LIBFDT=y
#CONFIG_SPL_ATF_SUPPORT=y
#CONFIG_SYS_MMCSD_RAW_MODE_U_BOOT_SECTOR=0x200
#CONFIG_SPL_ATF_TEXT_BASE=0x00010000
# -------  new  ---------
CONFIG_CMD_CACHE=y
CONFIG_CMD_DHRYSTONE=y
```
